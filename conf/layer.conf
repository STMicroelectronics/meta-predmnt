## conf/layer.conf
```bitbake
# We have a conf and classes directory, add to BBPATH
BBPATH .= ":${LAYERDIR}"

# We have recipes-* directories, add to BBFILES
BBFILES += "${LAYERDIR}/recipes-*/*.bb \
            ${LAYERDIR}/recipes-*/*.bbappend \
"

BBFILE_COLLECTIONS += "predmnt"
BBFILE_PATTERN_predmnt = "^${LAYERDIR}/"
BBFILE_PRIORITY_predmnt = "5"

LAYERDEPENDS_predmnt = "meta-python"

# Set a variable to get the openstlinux location
OPENSTLINUX_BASE = "${LAYERDIR}"

# This should only be incremented on significant changes that will
# cause compatibility issues with other layers
LAYERVERSION_predmnt = "1"
LAYERSERIES_COMPAT_predmnt = "thud"

# Packages needed by the Predictive Maintenance Platform.
IMAGE_INSTALL_append = "    \
	python-pip \
	python-dev \
	python3-pip \
	python3-dev \
	python-enum34 \
	python-futures \
	python3-pyserial \
	glib-2.0-dev \
	vim \
	git \
	packagegroup-core-buildessential \
	sqlite3 \
	ca-certificates \
	libffi-dev \
	zip \
	unzip \
	greengrass \
	predmnt \
"
```
